## drivers/pinctrl/sprd/Kconfig
```kconfig
# SPDX-License-Identifier: GPL-2.0-only
#
# Spreadtrum pin control drivers
#

config PINCTRL_SPRD
	tristate
	select PINMUX
	select PINCONF
	select GENERIC_PINCONF
	select GENERIC_PINMUX_FUNCTIONS
	help
	  Say Y here to enable Spreadtrum pinctrl driver

config PINCTRL_SPRD_SC9860
	tristate "Spreadtrum SC9860 pinctrl driver"
	depends on OF
	depends on ARCH_SPRD || COMPILE_TEST
	select PINCTRL_SPRD
	help
	  Say Y here to enable Spreadtrum SC9860 pinctrl driver

config PINCTRL_SPRD_QOGIRN6PRO
	tristate "Unisoc UMS9620 (qogirn6pro) pinctrl driver"
	depends on OF
	depends on ARCH_SPRD || COMPILE_TEST
	select PINCTRL_SPRD
	help
	  Say Y here to enable the Unisoc UMS9620 (qogirn6pro) pinctrl driver,
	  ported from Unisoc's 5.4 kernel.
```

## drivers/pmdomain/Kconfig
```kconfig
# SPDX-License-Identifier: GPL-2.0-only
menu "PM Domains"

source "drivers/pmdomain/actions/Kconfig"
source "drivers/pmdomain/amlogic/Kconfig"
source "drivers/pmdomain/apple/Kconfig"
source "drivers/pmdomain/arm/Kconfig"
source "drivers/pmdomain/bcm/Kconfig"
source "drivers/pmdomain/imx/Kconfig"
source "drivers/pmdomain/marvell/Kconfig"
source "drivers/pmdomain/mediatek/Kconfig"
source "drivers/pmdomain/qcom/Kconfig"
source "drivers/pmdomain/renesas/Kconfig"
source "drivers/pmdomain/rockchip/Kconfig"
source "drivers/pmdomain/samsung/Kconfig"
source "drivers/pmdomain/st/Kconfig"
source "drivers/pmdomain/starfive/Kconfig"
source "drivers/pmdomain/sunxi/Kconfig"
source "drivers/pmdomain/tegra/Kconfig"
source "drivers/pmdomain/thead/Kconfig"
source "drivers/pmdomain/ti/Kconfig"
source "drivers/pmdomain/xilinx/Kconfig"

config SPRD_UMS9620_IPA_PD
	bool "Unisoc UMS9620 IPA subsystem power domain"
	depends on ARCH_SPRD && PM
	select PM_GENERIC_DOMAINS
	select MFD_SYSCON
	default y

endmenu
```

## drivers/usb/typec/tcpm/Kconfig
```kconfig
# SPDX-License-Identifier: GPL-2.0

config TYPEC_TCPM
	tristate "USB Type-C Port Controller Manager"
	depends on USB
	select USB_ROLE_SWITCH
	select POWER_SUPPLY
	help
	  The Type-C Port Controller Manager provides a USB PD and USB Type-C
	  state machine for use with Type-C Port Controllers.

if TYPEC_TCPM

config TYPEC_TCPCI
	tristate "Type-C Port Controller Interface driver"
	depends on I2C
	select REGMAP_I2C
	help
	  Type-C Port Controller driver for TCPCI-compliant controller.

if TYPEC_TCPCI

config TYPEC_RT1711H
	tristate "Richtek RT1711H Type-C chip driver"
	help
	  Richtek RT1711H Type-C chip driver that works with
	  Type-C Port Controller Manager to provide USB PD and USB
	  Type-C functionalities.

config TYPEC_MT6360
	tristate "Mediatek MT6360 Type-C driver"
	depends on MFD_MT6360
	help
	  Mediatek MT6360 is a multi-functional IC that includes
	  USB Type-C. It works with Type-C Port Controller Manager
	  to provide USB PD and USB Type-C functionalities.

config TYPEC_TCPCI_MT6370
	tristate "MediaTek MT6370 Type-C driver"
	depends on MFD_MT6370
	help
	  MediaTek MT6370 is a multi-functional IC that includes
	  USB Type-C. It works with Type-C Port Controller Manager
	  to provide USB PD and USB Type-C functionalities.

	  This driver can also be built as a module. The module
	  will be called "tcpci_mt6370".

config TYPEC_TCPCI_MAXIM
	tristate "Maxim TCPCI based Type-C chip driver"
	help
	  MAXIM TCPCI based Type-C/PD chip driver. Works with
	  with Type-C Port Controller Manager.

endif # TYPEC_TCPCI

config TYPEC_FUSB302
	tristate "Fairchild FUSB302 Type-C chip driver"
	depends on I2C
	depends on EXTCON || !EXTCON
	help
	  The Fairchild FUSB302 Type-C chip driver that works with
	  Type-C Port Controller Manager to provide USB PD and USB
	  Type-C functionalities.

config TYPEC_WCOVE
	tristate "Intel WhiskeyCove PMIC USB Type-C PHY driver"
	depends on ACPI
	depends on MFD_INTEL_PMC_BXT
	depends on BXT_WC_PMIC_OPREGION
	help
	  This driver adds support for USB Type-C on Intel Broxton platforms
	  that have Intel Whiskey Cove PMIC. The driver works with USB Type-C
	  Port Controller Manager to provide USB PD and Type-C functionalities.

	  To compile this driver as module, choose M here: the module will be
	  called typec_wcove.ko

config TYPEC_UMP9620
	tristate "Unisoc UMP9620 Type-C and PD port controller (ZTE W200DS)"
	depends on MFD_SC27XX_PMIC && OF && REGULATOR && NVMEM && EXTCON
	depends on USB_ROLE_SWITCH && POWER_SUPPLY
	help
	  The USB-C port of the UMP9620 PMIC under TCPM: Type-C attach and
	  detach from the PMIC's own Type-C block, USB Power Delivery through
	  its PD block, the dwc3 data role and the charger's boost as VBUS,
	  and the port's DisplayPort alternate mode (software-node connector
	  with typec switch/mux references for the W200DS DP driver).
	  Experimental: it does nothing unless loaded with enable=1.

	  To compile this driver as a module, choose M here: the module will be
	  called ump9620-tcpc.

config TYPEC_QCOM_PMIC
	tristate "Qualcomm PMIC USB Type-C Port Controller Manager driver"
	depends on ARCH_QCOM || COMPILE_TEST
	depends on DRM || DRM=n
	select DRM_AUX_HPD_BRIDGE if DRM_BRIDGE && OF
	help
	  A Type-C port and Power Delivery driver which aggregates two
	  discrete pieces of silicon in the PM8150b PMIC block: the
	  Type-C port controller and the Power Delivery PHY.

	  This driver enables Type-C role switching, orientation, Alternate
	  mode and Power Delivery support both for VBUS and VCONN.

endif # TYPEC_TCPM
```
